## device/firmware/sdkconfig.defaults
```kconfig
CONFIG_LWIP_MAX_SOCKETS=16
CONFIG_HTTPD_MAX_REQ_HDR_LEN=1024
CONFIG_PARTITION_TABLE_CUSTOM=y
CONFIG_PARTITION_TABLE_CUSTOM_FILENAME="partitions.csv"
```
